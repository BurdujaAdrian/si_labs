#include "stdio_layer.h"
#include <stdio.h>
#include <Arduino.h>
// Code generated by claude
// start

int uart_putchar(char c, FILE *stream) {
	if (c == '\n') { uart_putchar('\r', stream); }
	while(!(UCSR0A & (1 << UDRE0)));
	UDR0 = c;
	return 0;
}

int uart_getchar(FILE *stream) {
	while(!(UCSR0A & (1 << RXC0)));
	return UDR0;
}

FILE uart_str = FDEV_SETUP_STREAM(uart_putchar, uart_getchar, _FDEV_SETUP_RW);

void uart_init(unsigned long baud){
	unsigned int ubrr = F_CPU/16/baud - 1;
	UBRR0H = (ubrr >> 8);
	UBRR0L = ubrr;
	UCSR0B = (1 << TXEN0) | (1 << RXEN0);
	UCSR0C = (3 << UCSZ00);

	stdout = &uart_str;
	stdin = &uart_str;
}

// end

void init_stdout(){ uart_init(9600); }

// IO
#define BUFFER_SIZE 255
char _buffer[BUFFER_SIZE+1];
char* buffer(){return _buffer;}

int _bufflen = 0;
int bufflen(){return _bufflen;}

void read_input(){
	fgets(_buffer, BUFFER_SIZE, stdin);
	_bufflen = strlen(_buffer);
}

void print_input(){ printf("%s", _buffer); }
